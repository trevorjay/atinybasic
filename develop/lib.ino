#include <SPI.h>
#include <SD.h>

const PROGMEM float coeffs[] = {1.76384252869671, 1.7154572200005442, 1.6351696263031674, 1.5766928552532127, 
                                1.3063456859075537, 1.191398608984867, 0.9857963844595683, 0.8104826280099796};
const PROGMEM float black[] = {
0.006878018379211426, 0.006935006483945974, 0.007106103713363648, 0.007391708330140939, 0.007792482496781619,
0.00830934986709432, 0.00894349222307339, 0.009696345165972634, 0.01056959287283113, 0.011565161932160159,
0.01268521427490911, 0.013932139219203735, 0.015308544649676376, 0.016817247354482902, 0.018461262545322876,
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0.008943492223073418, 0.008309349867094334, 0.007792482496781619, 0.007391708330140939, 0.0071061037133636346,
0.006935006483945974};

Sd2Card card;

volatile uint8_t sample;
volatile byte subTick;
volatile uint16_t playHead;
volatile uint32_t block;
volatile int blocks;

int hook = 0;

void lib_setup() {
  TCCR2A = 0b00000001;
  TCCR2B = 0b00000100;
  TIMSK2 = 0b00000000;
  OCR2B = 0;

  pinMode(2,OUTPUT);
  pinMode(3,OUTPUT);
  pinMode(A0,INPUT);

  delay(3000);

  if(!card.init(SPI_HALF_SPEED, 10)) {
    byte state = HIGH;
    for (byte i = 0; i < 6; i++) {
      digitalWrite(2,state);
      if (state == HIGH) { state = LOW; } else { state = HIGH; };
      delay(250);
    }
  }
  card.partialBlockRead(1);

  //calibrate on hook voltage
  digitalWrite(2,LOW);
  delay(1000);
  hook = analogRead(A0);
  hook = 0.9*hook;
  digitalWrite(2,HIGH);
  #if PHONE == 1
  while(analogRead(A0) > hook) {};
  #endif
  digitalWrite(2,LOW);
}

int dtmf() {
  int cur, num, r, c, buf[256];
  float mass, q0[8], q1[8], q2[8];
  byte last;

  #if CONSOLE == 1
  char keys[4][4] = {
    {'1','2','3','A'},
    {'4','5','6','B'},
    {'7','8','9','C'},
    {'*','0','#','D'}
  };
  #endif

  int nums[4][4] = {
    { 1, 2, 3,10},
    { 4, 5, 6,11},
    { 7, 8, 9,12},
    {14, 0,15,13}
  };

  num = 0;
  last = 0;
  while(1) {
    //bail if receiver is on the hook
    #if PHONE == 1
    if (analogRead(A0) > hook) {
      digitalWrite(2,HIGH);
      while(analogRead(A0) > hook) {};
      digitalWrite(2,LOW);
      return -1;
    }
    #else
    return -1;
    #endif

    // ~8887Hz
    for (int i = 0; i < 256; i++) {
      buf[i] = analogRead(A0);
    }

    memset(q0,0,8*sizeof(float));
    memset(q1,0,8*sizeof(float));
    memset(q2,0,8*sizeof(float));

    for (int n = 0; n < 256; n++) {
      float s = buf[n] * pgm_read_float_near(black + n);

      for (byte i = 0; i < 8; i++) {
        q0[i] = pgm_read_float_near(coeffs + i)*q1[i]-q2[i]+s;
        q2[i] = q1[i];
        q1[i] = q0[i];
      }

      for (byte i = 0; i < 8; i++) {
        q0[i] = sqrt(q1[i]*q1[i]+q2[i]*q2[i]-q1[i]*q2[i]*pgm_read_float_near(coeffs + i));
      }
    }

    mass = 0;
    for (byte j = 0; j < 8; j++) mass = mass + q0[j];

    r = -1;
    c = -1;
    for (byte i = 0; i < 8; i++) {
      if (q0[i]/mass > 0.3) {
        if (i < 4) {
          r = i;
        } else {
          c = i - 4;
        }
      }
    }

    if (r != -1 && c != -1) {
      digitalWrite(2,HIGH);

      if (last == 0) {
        last = 1;
        cur = nums[r][c];
        switch(cur) {
          case 15:
            last = 15;
            break;
          case 14:
            num = 0;
            break;
          default:
            num = num * 10;
            num = num + cur;
        }
      }

      #if CONSOLE == 1
      Serial.print(keys[r][c]);
      #endif
    } else {
      digitalWrite(2,LOW);

      if (last == 15) {
        #if CONSOLE == 1
        Serial.print("\n");
        #endif
        return num;
      }
      last = 0;

      #if CONSOLE == 1
      Serial.print("."); 
      #endif
    }

  }

}

int play(int superblock, int blks) {
  block = superblock*8;
  blocks = blks;
  subTick = 0;
  playHead = 0;
  OCR2B = 0;
  TCCR2A = 0b00100011;
  TCCR2B = 0b00000001;
  TIMSK2 = 0b00000001;
  while(blocks > 0) {
    if (analogRead(A0) > hook) {
      TCCR2A = 0b00000001;
      TCCR2B = 0b00000100;
      TIMSK2 = 0b00000000;
      OCR2B = 0;
      digitalWrite(2,HIGH);
      while(analogRead(A0) > hook) {};
      digitalWrite(2,LOW);
      return -1;
    }
  }
  TCCR2A = 0b00000001;
  TCCR2B = 0b00000100;
  TIMSK2 = 0b00000000;
  OCR2B = 0;
  return 1;
}


ISR(TIMER2_OVF_vect){
  if (blocks < 0) {
    OCR2B = 0;
    return;
  }
  OCR2B = sample;
  if (subTick++ < 7) return;
  subTick = 0;
  card.readData(block, playHead, 1, (uint8_t*) &sample);
  if (playHead++ < BLOCKSIZE) return;
  playHead = 0;
  block++;
  blocks--;
}
